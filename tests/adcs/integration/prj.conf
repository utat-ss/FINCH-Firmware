## CMakeLists.txt
```
cmake_minimum_required(VERSION 3.20.0)
find_package(Zephyr REQUIRED HINTS $ENV{ZEPHYR_BASE})
project(tests_adcs_dev_board)

include_directories(../../../include)

file(GLOB SOURCES src/*.c)

target_sources(app PRIVATE ${SOURCES})
```

## prj.conf
```kconfig
CONFIG_ZTEST=y
CONFIG_LOG=y
CONFIG_LOG_DEFAULT_LEVEL=3

# Configure UART as logging backend
CONFIG_GPIO=y
CONFIG_SERIAL=y
CONFIG_CONSOLE=y
CONFIG_UART_CONSOLE=y

# ADCS UART
CONFIG_UART_INTERRUPT_DRIVEN=y
CONFIG_UART_ASYNC_API=y
CONFIG_UART_USE_RUNTIME_CONFIGURE=y

CONFIG_FINCH_ADCS=y
```

## src/main.c
```c
/*
 * Copyright (c) 2025 The FINCH CubeSat Project Flight Software Contributors
 *
 * SPDX-License-Identifier: Apache-2.0
 */

#include <finch/adcs/adcs.h>

#include <zephyr/logging/log.h>
#include <zephyr/ztest.h>

LOG_MODULE_REGISTER(bench);

ZTEST_SUITE(basic_test, NULL, NULL, NULL, NULL, NULL);

ZTEST(basic_test, test_get_id)
{
	zassert_equal(adcs_init(), ADCS_RC_OK);

	uint8_t adcs_id[ADCS_ID_SIZE];
	zassert_equal(adcs_get_id(adcs_id, ADCS_ID_SIZE), ADCS_RC_OK);
}
```
