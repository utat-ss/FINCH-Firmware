## prj.conf
```kconfig
# SPDX-License-Identifier: Apache-2.0

CONFIG_ZTEST=y

CONFIG_LOG=y
CONFIG_LOG_DEFAULT_LEVEL=3
CONFIG_COMPILER_WARNINGS_AS_ERRORS=y

CONFIG_GPIO=y
CONFIG_SPI=y
CONFIG_SERIAL=y
CONFIG_CONSOLE=y
CONFIG_UART_CONSOLE=y

CONFIG_FINCH_CSP=y
CONFIG_FINCH_CSP_NODE_ADDRESS=1
```

## src/main.c
```c
/*
 * Copyright (c) 2026 The FINCH CubeSat Project Flight Software Contributors
 *
 * SPDX-License-Identifier: Apache-2.0
 */

#include <csp/csp.h>
#include <finch/csp/csp.h>
#include <zephyr/logging/log.h>

#include <zephyr/kernel.h>
#include <zephyr/ztest.h>

LOG_MODULE_REGISTER(bench);

ZTEST_SUITE(csp_ping, NULL, NULL, NULL, NULL, NULL);

ZTEST(csp_ping, test_ping_reply)
{
	int csp_rc;

    csp_rc = finch_csp_init();

    zassert_equal(csp_rc, 0);

    LOG_INF("CSP Initialized.");

    int res = csp_ping(0, 1000, 100, CSP_O_CRC32);

    zassert_false(res == -1);
}
```
