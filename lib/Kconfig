## lib/Kconfig
```kconfig
# Copyright (c) 2025 The FINCH CubeSat Project Flight Software Contributors
# SPDX-License-Identifier: Apache-2.0

menu "FINCH CubeSat Flight Software Libraries"

rsource "adcs/Kconfig"
rsource "adcs_service/Kconfig"
rsource "ccsds123b/Kconfig"
rsource "csp/Kconfig"
rsource "obc_flash/Kconfig"
rsource "obc_littlefs/Kconfig"

endmenu
```

## lib/adcs_service/Kconfig
```kconfig
# Copyright (c) 2026 The FINCH CubeSat Project Flight Software Contributors
# SPDX-License-Identifier: Apache-2.0

config FINCH_ADCS_SERVICE
	bool "FINCH ADCS CSP service"
	depends on FINCH_ADCS && FINCH_CSP
	help
	  CSP service that forwards ADCS commands received
	  over CSP to the ADCS library.
```

## lib/csp/Kconfig
```kconfig
# Copyright (c) 2026 The FINCH CubeSat Project Flight Software Contributors
# SPDX-License-Identifier: Apache-2.0

config FINCH_CSP
	bool "Enable FINCH CSP integration"
	select LIBCSP
	help
	  Build the FINCH libcsp integration layer.

if FINCH_CSP

config FINCH_CSP_NODE_ADDRESS
	int "CSP node address"
	range 0 16382
	default 1
	help
	  CSP address used for this image.
	  16383 is reserved as the CSP broadcast address.

config FINCH_CSP_HOSTNAME
	string "CSP hostname"
	default "finch"
	help
	  Hostname exposed via CSP management services.

config FINCH_CSP_MODEL
	string "CSP model"
	default "finch-flight-software"
	help
	  Model string exposed via CSP management services.

config FINCH_CSP_REVISION
	string "CSP revision"
	default "dev"
	help
	  Revision string exposed via CSP management services.

config FINCH_CSP_ROUTER_STACK_SIZE
	int "CSP router thread stack size"
	default 1024
	help
	  Stack size for the CSP router thread.

config FINCH_CSP_ROUTER_PRIORITY
	int "CSP router thread priority"
	default 1
	help
	  Zephyr thread priority for the CSP router thread.

config FINCH_CSP_CAN
	bool "Enable FINCH CSP CAN interface"
	depends on CAN
	select EVENTS
	help
	  Add a CSP interface over the board's chosen zephyr,canbus device.
	  Requires the board devicetree to set the zephyr,canbus chosen node.

	  The CSP CAN driver allocates its per-interface context from the
	  system heap, so CONFIG_HEAP_MEM_POOL_SIZE must be set large enough
	  to fit it (~1.3KB with default CSP CAN RX queue/thread settings).

endif # FINCH_CSP
```

## tests/adcs/integration/testcase.yaml
```yaml
tests:
  adcs.integration:
    tags: subsystem-integration-tests
    platform_allow: obc
```

## tests/external_flash_id/testcase.yaml
```yaml
tests:
  external_flash_id.basic:
    harness: ztest
    integration_platforms:
      - nucleo_h743zi
    platform_allow:
      - nucleo_h743zi
    tags:
      - external_flash
      - hardware
```
