## CMakeLists.txt
```
# Copyright (c) 2025 The FINCH CubeSat Project Flight Software Contributors
# SPDX-License-Identifier: Apache-2.0

cmake_minimum_required(VERSION 3.20.0)
find_package(Zephyr REQUIRED HINTS $ENV{ZEPHYR_BASE})
project(obc)

target_sources(app PRIVATE src/main.c)
```

## prj.conf
```kconfig
# SPDX-License-Identifier: Apache-2.0

CONFIG_LOG=y
CONFIG_LOG_DEFAULT_LEVEL=3
CONFIG_COMPILER_WARNINGS_AS_ERRORS=y

CONFIG_FINCH_CSP=y
CONFIG_FINCH_CSP_NODE_ADDRESS=1
CONFIG_FINCH_CSP_HOSTNAME="obc"
CONFIG_FINCH_CSP_CAN=y

# CSP CAN driver allocates its per-interface context from the system heap
CONFIG_HEAP_MEM_POOL_SIZE=4096


CONFIG_POSIX_SYSTEM_INTERFACES=y 

# configure littlefs for spi nor memory
CONFIG_SPI=y
CONFIG_FINCH_OBC_FLASH=y
CONFIG_FINCH_OBC_LITTLEFS=y
CONFIG_MAIN_STACK_SIZE=8192

# Configure UART as logging backend
CONFIG_GPIO=y
CONFIG_SERIAL=y
CONFIG_CONSOLE=y
CONFIG_WATCHDOG=y
CONFIG_UART_CONSOLE=y
CONFIG_IWDG_STM32=y
CONFIG_WDT_DISABLE_AT_BOOT=y

# Configure min/max watchdog window size
CONFIG_WDT_MAX_WINDOW=1000
CONFIG_WDT_MIN_WINDOW=0
CONFIG_WDT_OPT=0

# Configure watchdog check interval
CONFIG_WDT_CHECK_INTERVAL=100

CONFIG_CAN=y

# ADCS UART
CONFIG_UART_INTERRUPT_DRIVEN=y
CONFIG_UART_ASYNC_API=y
CONFIG_UART_USE_RUNTIME_CONFIGURE=y

CONFIG_FINCH_ADCS=y
CONFIG_FINCH_ADCS_SERVICE=y
```

## src/main.c
```c
/*
 * Copyright (c) 2025 The FINCH CubeSat Project Flight Software Contributors
 *
 * SPDX-License-Identifier: Apache-2.0
 */

#include <finch/adcs/adcs.h>
#include <finch/csp/csp.h>

#include <finch/obc_flash/util.h>
#include <lfs.h>
#include <lfs_util.h>
#include <finch/obc_littlefs/lfs_callbacks.h>

#include <zephyr/logging/log.h>
#include <zephyr/device.h>
#include <zephyr/drivers/watchdog.h>
#include <zephyr/kernel.h>
#include <zephyr/drivers/gpio.h>

#include <finch/adcs_service/adcs_service.h>

LOG_MODULE_REGISTER(obc);

/* SPI controller */
#define SPI_NODE DT_NODELABEL(spi1)
/* Manual CS GPIO. Controlling CS pin manually. */
#define CS_GPIO_NODE DT_NODELABEL(gpioa)
#define CS_PIN       4


// Filesystem configs
lfs_t lfs;
lfs_file_t file;

struct lfs_config cfg = {
    // block device operations
    .read  = lfs_cb_read,
    .prog  = lfs_cb_prog,
    .erase = lfs_cb_erase,
    .sync  = lfs_cb_sync,

    // block device configuration
    .read_size = 4,
    .prog_size = 4,
    .block_size = 4096,
    .block_count = 2048,
    .block_cycles = 500,
    .cache_size = 256,
    .lookahead_size = 16,
    .compact_thresh = 0,
};
struct lfs_flash_context flash_context;

int main(void)
{
	int csp_rc;
	adcs_rc_t adcs_rc;

	LOG_INF("Board Started");

	/*
	 *	Get internal watchdog from device tree. watchdog0 holdes the address to iwdg, which defines the device in the device tree
	 */
	const struct device *wdt = DEVICE_DT_GET(DT_ALIAS(watchdog0));
	int wdt_channel_id;

    // configuring SPI and GPIO devices for flash operations
    const struct device *spi = DEVICE_DT_GET(SPI_NODE);
    const struct device *gpio = DEVICE_DT_GET(CS_GPIO_NODE);
    int ret = gpio_pin_configure(gpio, CS_PIN, GPIO_OUTPUT_HIGH);
	if (ret != 0) {
		LOG_ERR("Failed to configure GPIO pin");
		return ret;
	}

    // unlock flash memory to allow write/erase operations
    ret = obc_flash_global_unlock(spi, gpio, CS_PIN);
	if (ret != 0) {
		LOG_ERR("Failed to unlock flash memory");
		return ret;
	}

    // configure flash context for littlefs
    flash_context.spi = spi;
    flash_context.gpio = gpio;
    flash_context.cs_pin = CS_PIN;
    cfg.context = &flash_context;
    // mount littlefs filesystem, format if mount fails
    int fs_err = lfs_mount(&lfs, &cfg);
    if (fs_err) {
        LOG_INF("Failed to mount filesystem, formatting and retrying...");
        fs_err = lfs_format(&lfs, &cfg);
		if (fs_err) {
			LOG_ERR("Failed to format filesystem");
            return fs_err;
		}

        // retry mounting after formatting
        fs_err = lfs_mount(&lfs, &cfg);
        if (fs_err) {
            LOG_ERR("Failed to mount filesystem after formatting");
            return fs_err;
        }
    }

	if (!device_is_ready(wdt)) {
		LOG_ERR("%s: device is not ready", wdt->name);
		return 0;
	}

	struct wdt_timeout_cfg wdt_config = {
		/* Reset SoC when watchdog downcounter reaches 0. */
		.flags = WDT_FLAG_RESET_SOC,

		/* Set min and max time window for feeding the timer */
		.window.min = CONFIG_WDT_MIN_WINDOW,
		.window.max = CONFIG_WDT_MAX_WINDOW,
	};

	wdt_channel_id = wdt_install_timeout(wdt, &wdt_config);

	/* Timeout configuration setup */

	if (wdt_channel_id < 0) {
		LOG_ERR("Internal watchdog install error");
		return wdt_channel_id;
	}

	int wdt_err = wdt_setup(wdt, CONFIG_WDT_OPT);

	if (wdt_err < 0) {
		LOG_ERR("Internal watchdog setup error");
		return wdt_err;
	}

	adcs_rc = adcs_init();
	if (adcs_rc != ADCS_RC_OK) {
		LOG_ERR("Failed to initialize ADCS (%d)", adcs_rc);
		return adcs_rc;
	}

	LOG_INF("ADCS READY");

	csp_rc = finch_csp_init();
	if (csp_rc != 0) {
		LOG_ERR("Failed to initialize CSP (%d)", csp_rc);
		return csp_rc;
	}

	LOG_INF("CSP READY");

	csp_rc = adcs_service_init();
	if (csp_rc != 0) {
		LOG_ERR("Failed to initialize CSP ADCS service (%d)", csp_rc);
		return csp_rc;
	}

	LOG_INF("ADCS CSP SERVICE READY");

	while (1) {

		/*
		 *	Main loop runs here. If it hangs, feeding will not run
		 */

		int wdt_ret = wdt_feed(wdt, wdt_channel_id);

		if (wdt_ret < 0) {
			LOG_ERR("Failed to feed the watchdog");
			return 0;
		}
		k_msleep(CONFIG_WDT_CHECK_INTERVAL);
	}

	return 0;
}
```

## src/adcs_service.c
```c
/*
 * Copyright (c) 2026 The FINCH CubeSat Project Flight Software Contributors
 *
 * SPDX-License-Identifier: Apache-2.0
 */

#include "adcs_service.h"
#include <csp/csp.h>
#include <errno.h>
#include <zephyr/logging/log.h>
#include <zephyr/kernel.h>
#include <finch/adcs/adcs.h>
#include <string.h>

LOG_MODULE_REGISTER(adcs_service);

#define ADCS_CMD_PORT 10
#define ADCS_CMD_BACKLOG 5 // Justification needed
#define ADCS_READ_TIMEOUT_MS 1000
#define ADCS_SERVICE_THREAD_PRIORITY 2

static csp_socket_t sock = {0};
static struct k_thread adcs_service_thread_data;
static k_tid_t adcs_service_tid;
K_THREAD_STACK_DEFINE(adcs_service_stack, 1024);

static void adcs_service_handler(csp_conn_t *conn)
{
	csp_packet_t *req_packet;
	csp_packet_t *res_packet;
	struct adcs_service_cmd cmd;
	struct adcs_service_res res = {0};
	adcs_rc_t adcs_rc;

	/* For now, we assume a single packet for each command. */
	req_packet = csp_read(conn, ADCS_READ_TIMEOUT_MS);
	if (req_packet == NULL) {
		LOG_WRN("No request received on ADCS service port");
		csp_close(conn);
		return;
	}
	memcpy(&cmd, req_packet->data, sizeof(struct adcs_service_cmd));
	csp_buffer_free(req_packet);
	res.cmd_type = cmd.type;

	LOG_INF("ADCS CMD: [0x%X]", cmd.type);

	// Build response
	switch (cmd.type) {
	case ADCS_SERVICE_CMD_GET_ID:
		adcs_rc = adcs_get_id(res.data.id, sizeof(res.data.id));
		if (adcs_rc == ADCS_RC_ERR) {
			LOG_ERR("Failed to get ADCS ID (%d)", adcs_rc);
			res.status = ADCS_SERVICE_ERR_ADCS;
		} else {
			res.status = ADCS_SERVICE_OK;
		}
		break;
	default:
		LOG_WRN("Unknown ADCS command [0x%X]", cmd.type);
		res.status = ADCS_SERVICE_ERR_UNKNOWN_CMD;
		break;
	}

	// Send response
	res_packet = csp_buffer_get(0);
	if (res_packet == NULL) {
		LOG_ERR("Failed to allocate ADCS response buffer");
		csp_close(conn);
		return;
	}
	memcpy(res_packet->data, &res, sizeof(res));
	res_packet->length = sizeof(res);
	csp_send(conn, res_packet);

	csp_close(conn);
}

static void adcs_service_thread(void *p1, void *p2, void *p3)
{
	ARG_UNUSED(p1);
	ARG_UNUSED(p2);
	ARG_UNUSED(p3);

	LOG_INF("Listening for ADCS Commands on port %u", ADCS_CMD_PORT);

	while (1) {
		csp_conn_t *conn = csp_accept(&sock, CSP_MAX_TIMEOUT);
		if (conn == NULL) {
			LOG_ERR("Failed to accept connection on ADCS service port %u", ADCS_CMD_PORT);
			continue;
		}

		adcs_service_handler(conn);
	}
}

int adcs_service_init(void)
{
	int err;

	err = csp_bind(&sock, ADCS_CMD_PORT);
	if (err != CSP_ERR_NONE) {
		LOG_ERR("Failed to bind ADCS service port %u (%d)", ADCS_CMD_PORT, err);
		return -EIO;
	}

	err = csp_listen(&sock, ADCS_CMD_BACKLOG);
	if (err != CSP_ERR_NONE) {
		LOG_ERR("Failed to listen on ADCS service port %u (%d)", ADCS_CMD_PORT, err);
		return -EIO;
	}

	adcs_service_tid = k_thread_create(
		&adcs_service_thread_data,
		adcs_service_stack,
		K_THREAD_STACK_SIZEOF(adcs_service_stack),
		adcs_service_thread,
		NULL, NULL, NULL,
		ADCS_SERVICE_THREAD_PRIORITY,
		0,
		K_NO_WAIT
	);

	if (adcs_service_tid == NULL) {
		LOG_ERR("Failed to create ADCS service thread");
		return -1;
	}

	return 0;
}
```

## src/adcs_service.h
```c
/*
 * Copyright (c) 2026 The FINCH CubeSat Project Flight Software Contributors
 *
 * SPDX-License-Identifier: Apache-2.0
 */
#ifndef FINCH_ADCS_SERVICE_H
#define FINCH_ADCS_SERVICE_H

#include <finch/adcs/adcs.h>

enum adcs_service_cmd_type {
	ADCS_SERVICE_CMD_GET_ID = 0x01,
};

struct adcs_service_cmd {
    uint8_t type; /* enum adcs_service_cmd_type */
};

enum adcs_service_status {
	ADCS_SERVICE_OK = 0x00,
	ADCS_SERVICE_ERR_UNKNOWN_CMD = 0x01,
	ADCS_SERVICE_ERR_ADCS = 0x02,
};

struct adcs_service_res {
    uint8_t status; /* enum adcs_service_res_type */
    uint8_t cmd_type; /* enum adcs_service_cmd_type */
    union {
        uint8_t id[ADCS_ID_SIZE];
    } data;
};

int adcs_service_init(void);

#endif /* FINCH_ADCS_SERVICE_H */
```
